intc: interrupt-controller@a0021000 {
	compatible = "arm,cortex-a7-gic";
	#interrupt-cells = <3>;
	interrupt-controller;
	reg = <0xa0021000 0x1000>, <0xa0022000 0x2000>;
};

rcc: rcc@50000000 {
	compatible = "st,stm32mp1-rcc", "syscon";
	reg = <0x50000000 0x1000>;
	#clock-cells = <1>;
	#reset-cells = <1>;
};

dmamux1: dma-router@48002000 {
	compatible = "st,stm32h7-dmamux";
	reg = <0x48002000 0x1c>;
	#dma-cells = <3>;
	clocks = <&rcc DMAMUX>;
	resets = <&rcc DMAMUX_R>;
};

spi3: spi@4000c000 {
	interrupts = <GIC_SPI 51 IRQ_TYPE_LEVEL_HIGH>;
	clocks = <&rcc SPI3_K>;
	resets = <&rcc SPI3_R>;
	dmas = <&dmamux1 61 0x400 0x05>, <&dmamux1 62 0x400 0x05>;
};
